## conf/local.conf
```bitbake
# CONF_VERSION is increased each time conf/ changes incompatibly
CONF_VERSION = "1"

# Removes source after build.
#INHERIT += "rm_work"
#RM_WORK_EXCLUDE += ""

# Set DEPLOY_DIR outside of TMPDIR
DEPLOY_DIR = "${TMPDIR}/../deploy/${TCLIBC}"

# Don't generate the mirror tarball for SCM repos, the snapshot is enough
BB_GENERATE_MIRROR_TARBALLS = "0"

#
# Parallelism Options
#
# These two options control how much parallelism BitBake should use.
# The first option determines how many tasks bitbake should run in parallel:
# Default to setting automatically based on cpu count
BB_NUMBER_THREADS ?= "${@oe.utils.cpu_count()}"
#
# The second option controls how many processes make should run in parallel
# when running compile tasks:
# Default to setting automatically based on cpu count
PARALLEL_MAKE ?= "-j ${@oe.utils.cpu_count()}"


#
# Shared-state files from other locations
#
# Shared state files are prebuilt cache data objects which can used to
# accelerate build time. This variable can be used to configure the system to
# search other mirror locations for these objects before it builds the data
# itself.
#
# This can be a filesystem directory, or a remote url such as http or ftp.
# These would contain the sstate-cache results from previous builds (possibly
# from other machines). This variable works like fetcher MIRRORS/PREMIRRORS
# and points to the cache locations to check for the shared objects.
#SSTATE_MIRRORS ?= "\
#file://.* http://someserver.tld/share/sstate/ \n \
#file://.* file:///some/local/dir/sstate/"

#SSTATE_MIRRORS ?= "\
#file://.* http://dominion.thruhere.net/angstrom/sstate-mirror/ \n "

SSTATE_DUPWHITELIST += "${DEPLOY_DIR}/licences"

# enable PR service on build machine itself its good for a case when this is
# the only builder generating the feeds
#
PRSERV_HOST = "localhost:0"

# If ENABLE_BINARY_LOCALE_GENERATION is set to "1", you can limit locales
# generated to the list provided by GLIBC_GENERATE_LOCALES. This is huge
# time-savior for developmental builds.
ENABLE_BINARY_LOCALE_GENERATION = "1"
# Specifies the list of GLIBC locales to generate to save some build time.
# http://www.yoctoproject.org/docs/current/ref-manual/ref-manual.html#var-GLIBC_GENERATE_LOCALES
GLIBC_GENERATE_LOCALES += " \
    en_US.UTF-8 \
"

# WORK-AROUND: Cannot build webkitgtk without opengl
DISTRO_FEATURES += "x11 opengl"
```
